## customer/boards/Kconfig
```kconfig
#
# Kconfig to support customer boards
#

config MACH_MESON3_F04
	depends on ARCH_MESON3
	bool "Meson3 f04 board"
	help
	  Support for Amlogic Meson3 f04 customer platform.
	 
config MACH_MESON6_G04
	depends on ARCH_MESON6
	bool "Meson6 g04 board"
	help
	  Support for Amlogic Meson6 g04 customer platform.

config MACH_MESON6_G06
	depends on ARCH_MESON6
	bool "Meson6 g06 board"
	help
	  Support for Amlogic Meson6 g06 customer platform.

config MACH_MESON6_G06_E3
	depends on ARCH_MESON6
	bool "Meson6 g06_e3 board"
	help
	  Support for Amlogic Meson6 g06_e3 customer platform.
	  
config MACH_MESON6_G06_848
	depends on ARCH_MESON6
	bool "Meson6 g06_848 board"
	help
	  Support for Amlogic Meson6 g06_848 customer platform.

config MACH_MESON6_G08
	depends on ARCH_MESON6
	bool "Meson6 g08 board"
	help
	  Support for Amlogic Meson6 g08 customer platform.

config MACH_MESON6_G08_768
	depends on ARCH_MESON6
	bool "Meson6 g08_768 board"
	help
	  Support for Amlogic Meson6 g08_768 customer platform.

config MACH_MESON6_G06_E4
	depends on ARCH_MESON6
	bool "Meson6 g06_e4 board"
	help
	  Support for Amlogic Meson6 g06_e4 customer platform.

config MACH_MESON6_G06_E4_AINOL
	depends on ARCH_MESON6
	bool "Meson6 g06_e4_ainol board"
	help
	  Support for Amlogic Meson6 g06_e4_ainol customer platform.

config MACH_MESON6_G06_E4_JINLI
	depends on ARCH_MESON6
	bool "Meson6 g06_e4_jinli board"
	help
	  Support for Amlogic Meson6 g06_e4_jinli customer platform.
config MACH_MESON6_G08_EM1060
        depends on ARCH_MESON6
        bool "Meson6 g08_em1060 board"
        help
          Support for Amlogic Meson6 g08 em1060 customer platform.
		  
config MACH_MESON6_G08_EM9760
        depends on ARCH_MESON6
        bool "Meson6 g08_em9760 board"
        help
          Support for Amlogic Meson6 g08 em9760 customer platform.

config MACH_MESON6_G24
	depends on ARCH_MESON6
	bool "Meson6 g24 board"
	help
	  Support for Amlogic Meson6 g24 customer platform.

config MACH_MESON6_G24_G6
        depends on ARCH_MESON6
        bool "Meson6 g24 G6 board"
        help
          Support for Amlogic Meson6 g24 G6 customer platform.

config MACH_MESON6_G24_K8                                             
          depends on ARCH_MESON6                                      
          bool "Meson6 g24_k8 board"                                
          help                                                      
            Support for Amlogic Meson6 g24_k8 customer platform.  
                                                                   
config MACH_MESON6_G14
	depends on ARCH_MESON6
	bool "Meson6 g14 board"
	help
	  Support for Amlogic Meson6 g14 customer platform.

config MACH_MESON6_G14_PT840
	depends on ARCH_MESON6
	bool "Meson6 g14 PT840 board"
	help
	  Support for Amlogic Meson6 g14 PT840 customer platform.

config MACH_MESON6_G12_M1005
	depends on ARCH_MESON6
	bool "Meson6 g12 M1005 board"
	help
	  Support for Amlogic Meson6 g12 M1005 customer platform.

config MACH_MESON6_G12_M805
	depends on ARCH_MESON6
	bool "Meson6 g12 M805 board"
	help
	  Support for Amlogic Meson6 g12 M805 customer platform.

config MACH_MESON6_G11_E8
	depends on ARCH_MESON6
	bool "Meson6 g11_e8 board"
	help
	  Support for Amlogic Meson6 g11_e8 customer platform.	  

config TC103
	depends on MACH_MESON6_G11_E8
	bool "tc103 config for g11 e8 bsp"
	help
	  config tc103 for g11 e8

config MACH_MESON6_G11_N8
	depends on ARCH_MESON6
	bool "Meson6 g11_n8 board"
	help
	  Support for Amlogic Meson6 g11_n8 customer platform.	  
```

## customer/drivers/lightsensor/Kconfig
```kconfig
#
# LightSensor driver configuration
#

menuconfig MESON_LIGHT_SENSOR
	bool "LightSensor"
	help
	  Say Y here, and a list of supported touchscreens will be displayed.
	  This option doesn't affect the kernel.

	  If unsure, say Y.

if MESON_LIGHT_SENSOR

config LITE_ON_LIGHT_SENSOR_LTR501
	tristate "Lite On I2C light sensor ltr501"
	depends on I2C
	default n
	help
	  Say Y here if you want to use the light sensor ltr501.

endif # MESON_INPUT_TOUCHSCREEN
```

## customer/drivers/touchscreen/Kconfig
```kconfig
#
# Touchscreen driver configuration
#

menuconfig MESON_INPUT_TOUCHSCREEN
	bool "Touchscreens"
	help
	  Say Y here, and a list of supported touchscreens will be displayed.
	  This option doesn't affect the kernel.

	  If unsure, say Y.

if MESON_INPUT_TOUCHSCREEN

config FOCALTECH_CAPACITIVE_TOUCHSCREEN_G06
	tristate "FocalTech I2C capacitive touchscreen for g06"
	depends on I2C
	default n
	help
	  Say Y here if you want to use the FocalTech 5X06 capacitive panel.

config FOCALTECH_CAPACITIVE_TOUCHSCREEN_G12_ANDA_M1005A
	tristate "FocalTech I2C capacitive touchscreen for g12 anda 1024*768 M1005A"
	depends on I2C
	default n
	help
	  Say Y here if you want to use the FocalTech 5X06 capacitive panel.
config FOCALTECH_CAPACITIVE_TOUCHSCREEN_G12_ANDA_M805A
	tristate "FocalTech I2C capacitive touchscreen for g12 anda 1024*768 M805A"
	depends on I2C
	default n
	help
	  Say Y here if you want to use the FocalTech 5X06 capacitive panel.
config IPS_BD7248F_TOUCHSCREEN
	tristate "IPS_BD7248F touch panel"
	depends on I2C 
	default n
	help
	  Say Y here if you want to use the IPS capacitive panel.
	  
config IPS_BC8601_TOUCHSCREEN
	tristate "IPS_BC8601 for e4 touch panel"
	depends on I2C 
	default n
	help
	  Say Y here if you want to use the IPS capacitive panel.

config GOODIX_GT801_CAPACITIVE_TOUCHSCREEN
	tristate "Goodix GT801 capacitive touchscreen"
	depends on I2C
	default n
	help
	  Say Y here if you want to use the Goodix capacitive panel.
	  
	  To compile this driver as a module, choose M here: the
	  module will be called . 

config GOODIX_GT810_CAPACITIVE_TOUCHSCREEN
	tristate "Goodix GT810 capacitive touchscreen"
	depends on I2C
	default n
	help
	  Say Y here if you want to use the Goodix capacitive panel.
	  
	  To compile this driver as a module, choose M here: the
	  module will be called . 

config EGL_ASD_TOUCHSCREEN
        tristate "Only use for ASD touch panel"
        depends on I2C
        default n
        help
          Say Y here if you want to use the IPS capacitive panel.

config MG8698S_CAPACITIVE_TOUCHSCREEN
	tristate "MG8698S capacitive touch panel"
	depends on I2C
	default n
	help
	  Say Y here if you want to use the MG8698S capacitive panel.

	  To compile this driver as a module, choose M here: the
	  module will be called .	  

config SSD25XX_CAPACITIVE_TOUCHSCREEN
        tristate "SSD25xx I2C capacitive touchscreen for g24"
        depends on I2C
        default n
        help
          Say Y here if you want to use the ssd2533 capacitive panel.
	  
config FOCALTECH_CAPACITIVE_TOUCHSCREEN_G24
	tristate "FocalTech I2C capacitive touchscreen for g24"
	depends on I2C
	default n
	help
	  Say Y here if you want to use the FocalTech 5X06 capacitive panel.
config NOVATEK_TOUCHSCREEN_NEW
        tristate "Novatek capacitive touch panel new driver"
        depends on I2C
        default n
        help
          Say Y here if you want to use the novatek capacitive panel.

          To compile this driver as a module, choose M here: the
          module will be called 
	  
config FOCALTECH_CAPACITIVE_TOUCHSCREEN_G06_E4
	tristate "FocalTech I2C capacitive touchscreen for g06E4"
	depends on I2C
	default n
	help
	  Say Y here if you want to use the FocalTech 5X06 capacitive panel.
	  
config GOODIX_CHIP2_CAPACITIVE_TOUCHSCREEN
	tristate "Goodix touch 2 chip capacitive touch panel"
	depends on I2C
	default n
	help
	  Say Y here if you want to use the touch 2 chip capacitive panel.

	  To compile this driver as a module, choose M here: the
	  module will be called .	  
	  
endif # MESON_INPUT_TOUCHSCREEN
```

## customer/drivers/vout/Kconfig
```kconfig
#
# Video output configuration
#
menu "Amlogic LCD T3 module"
	
config AM_LCD_T3		
	tristate "LCD T3 control"
	default n
	help
		LCD T3 control
endmenu
	
```
